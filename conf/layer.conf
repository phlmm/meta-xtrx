## conf/layer.conf
```bitbake
# We have a conf and classes directory, add to BBPATH
BBPATH .= ":${LAYERDIR}"

# We have recipes-* directories, add to BBFILES
BBFILES += "${LAYERDIR}/recipes-*/*/*.bb \
            ${LAYERDIR}/recipes-*/*/*.bbappend"

BBFILE_COLLECTIONS += "meta-xtrx"
BBFILE_PATTERN_meta-xtrx = "^${LAYERDIR}/"
BBFILE_PRIORITY_meta-xtrx = "6"

LAYERDEPENDS_meta-xtrx = "core"
LAYERSERIES_COMPAT_meta-xtrx = "whinlatter"
```
